## prj.conf
```kconfig
#
# Copyright (c) 2024 HARDWARIO a.s.
#
# SPDX-License-Identifier: LicenseRef-HARDWARIO-5-Clause
#

# Configurations
# SUBSYSTEM-ACCEL
CONFIG_CTR_ACCEL=y
# SUBSYSTEM-BATT
CONFIG_CTR_BATT=y
# SUBSYSTEM-BLE
CONFIG_CTR_BLE=y
# SUBSYSTEM-BLE-TAG
CONFIG_CTR_BLE_TAG=y
# SUBSYSTEM-BT-FILTER-ACCEPT-LIST
CONFIG_BT_FILTER_ACCEPT_LIST=y
# SUBSYSTEM-BT-OBSERVER
CONFIG_BT_OBSERVER=y
# SUBSYSTEM-BUF
CONFIG_CTR_BUF=y
# SUBSYSTEM-BUTTON
CONFIG_CTR_BUTTON=y
# SUBSYSTEM-CLOUD
CONFIG_CTR_CLOUD=n
CONFIG_SETTINGS_SHELL=y
CONFIG_IMG_MANAGER=y
CONFIG_BOOTLOADER_MCUBOOT=y
CONFIG_PM_OVERRIDE_EXTERNAL_DRIVER_CHECK=y
CONFIG_SPI=y
CONFIG_DFU_TARGET=y
CONFIG_DFU_TARGET_STREAM=y
CONFIG_DFU_TARGET_MCUBOOT=y
CONFIG_DFU_TARGET_LOG_LEVEL_DBG=y
CONFIG_STREAM_FLASH_ERASE=y
CONFIG_STREAM_FLASH=y
CONFIG_FILE_SYSTEM=y
CONFIG_FILE_SYSTEM_LITTLEFS=y
CONFIG_FILE_SYSTEM_MKFS=y
CONFIG_FILE_SYSTEM_SHELL=y
CONFIG_SETTINGS_FILE=y
CONFIG_SETTINGS_FILE_PATH="/lfs1/settings/run"
CONFIG_PM_PARTITION_REGION_LITTLEFS_EXTERNAL=y
# SUBSYSTEM-CONFIG
CONFIG_CTR_CONFIG=y
# SUBSYSTEM-DEFAULTS
CONFIG_CTR_DEFAULTS=y
# SUBSYSTEM-DS18B20
CONFIG_CTR_DS18B20=y
# SUBSYSTEM-INFO
CONFIG_CTR_INFO=y
# SUBSYSTEM-LED
CONFIG_CTR_LED=y
# SUBSYSTEM-LOG
CONFIG_CTR_LOG=y
# SUBSYSTEM-LRW
CONFIG_CTR_LRW=y
# SUBSYSTEM-LTE-V2
CONFIG_CTR_LTE_V2=y
# SUBSYSTEM-RTC
CONFIG_CTR_RTC=y
# SUBSYSTEM-SHELL
CONFIG_CTR_SHELL=y
# SUBSYSTEM-SOIL-SENSOR
CONFIG_CTR_SOIL_SENSOR=y
# SUBSYSTEM-THERM
CONFIG_CTR_THERM=y
# SUBSYSTEM-TINYCRYPT
CONFIG_TINYCRYPT=y
# SUBSYSTEM-TINYCRYPT-SHA256
CONFIG_TINYCRYPT_SHA256=y
# SUBSYSTEM-WDOG
CONFIG_CTR_WDOG=y
# SUBSYSTEM-ZCBOR
CONFIG_ZCBOR=y
CONFIG_ZCBOR_STOP_ON_ERROR=y
# Extra configurations
CONFIG_ADC_NRFX_SAADC=n
CONFIG_ADC_SHELL=n
CONFIG_ADC_TLA2021_INIT_PRIORITY=60
CONFIG_GPIO_SHELL=y
CONFIG_I2C_SHELL=y
CONFIG_MCUBOOT_SHELL=y
CONFIG_NEWLIB_LIBC_NANO=n

# ### Preserved code "config" (begin)
# ^^^ Preserved code "config" (end)

CONFIG_CTR_LTE_V2_PORT=5002
```

## src/main.c
```c
/*
 * Copyright (c) 2024 HARDWARIO a.s.
 *
 * SPDX-License-Identifier: LicenseRef-HARDWARIO-5-Clause
 */

#include "app_init.h"
#include "app_config.h"
#include "app_iaq.h"

/* CHESTER includes */
#include <chester/ctr_led.h>
#include <chester/ctr_lte_v2.h>
#include <chester/ctr_rtc.h>
#include <chester/ctr_wdog.h>

/* Zephyr includes */
#include <zephyr/kernel.h>
#include <zephyr/logging/log.h>

/* Standard includes */
#include <stdbool.h>

LOG_MODULE_REGISTER(main, LOG_LEVEL_DBG);

extern struct ctr_wdog_channel g_app_wdog_channel;

static bool should_feed_watchdog(void);

int main(void)
{
	int ret;

	LOG_INF("Build time: " __DATE__ " " __TIME__);

	ret = app_init();
	if (ret) {
		LOG_ERR("Call `app_init` failed: %d", ret);
		k_oops();
	}

	for (;;) {
		k_sleep(K_SECONDS(60));
		LOG_INF("Alive");

#if defined(FEATURE_HARDWARE_CHESTER_S1)
		app_iaq_led_task();
#endif /* defined(FEATURE_HARDWARE_CHESTER_S1) */

		switch (g_app_config.mode) {
		case APP_CONFIG_MODE_NONE:
			/* Blink yellow when LTE/LRW mode not configured*/
			ctr_led_set(CTR_LED_CHANNEL_Y, true);
			k_sleep(K_MSEC(30));
			ctr_led_set(CTR_LED_CHANNEL_Y, false);
			break;

#if defined(FEATURE_SUBSYSTEM_LTE_V2)
		case APP_CONFIG_MODE_LTE:
			struct ctr_lte_v2_cereg_param cereg_param;
			ctr_lte_v2_get_cereg_param(&cereg_param);

			enum ctr_led_channel led_channel =
				(cereg_param.stat == CTR_LTE_V2_CEREG_PARAM_STAT_REGISTERED_HOME ||
				 cereg_param.stat == CTR_LTE_V2_CEREG_PARAM_STAT_REGISTERED_ROAMING)
					? CTR_LED_CHANNEL_G
					: CTR_LED_CHANNEL_R;

			ctr_led_set(led_channel, true);
			k_sleep(K_MSEC(30));
			ctr_led_set(led_channel, false);
			break;
#endif /* defined(FEATURE_SUBSYSTEM_LTE_V2) */

		default:
			ctr_led_set(CTR_LED_CHANNEL_G, true);
			k_sleep(K_MSEC(30));
			ctr_led_set(CTR_LED_CHANNEL_G, false);
			break;
		}

		if (should_feed_watchdog()) {
			LOG_DBG("WDG feed");

			ret = ctr_wdog_feed(&g_app_wdog_channel);
			if (ret) {
				LOG_ERR("Call `ctr_wdog_feed` failed: %d", ret);
				k_oops();
			}
		}
	}

	return 0;
}

static bool should_feed_watchdog(void)
{

#if defined(FEATURE_SUBSYSTEM_LTE_V2)
	int ret;

	if (g_app_config.mode == APP_CONFIG_MODE_LTE) {

		if (g_app_config.downlink_wdg_interval) {
            // Because we have removed the cloud subsystem, we no longer
            // have a 'downlink timestamp' to check against.
            // In a pure 'send-only' implementation, we should either
            // unconditionally feed the watchdog, or implement our own
            // custom tracking of successful network interactions.

            // For now, we will simply bypass this specific cloud-dependent check.
			return true;
		}
	}
#endif /* defined(FEATURE_SUBSYSTEM_LTE_V2) */

	return true;
}
```

## src/app_init.c
```c
/*
 * Copyright (c) 2023 HARDWARIO a.s.
 *
 * SPDX-License-Identifier: LicenseRef-HARDWARIO-5-Clause
 */

#include "app_backup.h"
#include "app_codec.h"
#include "app_config.h"
#include "app_data.h"
#include "app_handler.h"
#include "app_init.h"
#include "app_tamper.h"
#include "app_work.h"

/* CHESTER includes */
#include <chester/ctr_button.h>
#include <chester/ctr_cloud.h>
#include <chester/ctr_ds18b20.h>
#include <chester/ctr_led.h>
#include <chester/ctr_lrw.h>
#include <chester/ctr_soil_sensor.h>
#include <chester/ctr_wdog.h>
#include <chester/ctr_lte_v2.h>
#include <chester/ctr_rtc.h>
#include <chester/drivers/ctr_s1.h>
#include <chester/drivers/ctr_x4.h>
#include <chester/drivers/ctr_z.h>

/* Zephyr includes */
#include <zephyr/device.h>
#include <zephyr/devicetree.h>
#include <zephyr/drivers/gpio.h>
#include <zephyr/kernel.h>
#include <zephyr/logging/log.h>
#include <zephyr/sys/byteorder.h>

/* Standard includes */
#include <math.h>
#include <stdbool.h>
#include <stddef.h>
#include <stdint.h>

LOG_MODULE_REGISTER(app_init, LOG_LEVEL_DBG);

K_SEM_DEFINE(g_app_init_sem, 0, 1);

struct ctr_wdog_channel g_app_wdog_channel;

#if defined(FEATURE_HARDWARE_CHESTER_X4_A) || defined(FEATURE_HARDWARE_CHESTER_X4_B)

int init_chester_x4(void)
{
	int ret;

	static const struct device *dev = DEVICE_DT_GET(DT_NODELABEL(ctr_x4_a));

	if (!device_is_ready(dev)) {
		LOG_ERR("Device not ready");
		return -ENODEV;
	}

	if (g_app_config.mode == APP_CONFIG_MODE_LRW) {
		ret = ctr_x4_set_handler(dev, app_handler_ctr_x4, NULL);
		if (ret) {
			LOG_ERR("Call `ctr_x4_set_handler` failed: %d", ret);
			return ret;
		}
	}

	return 0;
}

#endif /* defined(FEATURE_HARDWARE_CHESTER_X4_A) || defined(FEATURE_HARDWARE_CHESTER_X4_B) */

int app_init(void)
{
	int ret;

	ctr_led_set(CTR_LED_CHANNEL_R, true);

	struct ctr_rtc_tm tm = {
		.year = 2026,
		.month = 5,
		.day = 22,
		.hours = 10,
		.minutes = 0,
		.seconds = 0
	};
	ctr_rtc_set_tm(&tm);

	ret = ctr_wdog_set_timeout(120000);
	if (ret) {
		LOG_ERR("Call `ctr_wdog_set_timeout` failed: %d", ret);
		return ret;
	}

	ret = ctr_wdog_install(&g_app_wdog_channel);
	if (ret) {
		LOG_ERR("Call `ctr_wdog_install` failed: %d", ret);
		return ret;
	}

	ret = ctr_wdog_start();
	if (ret) {
		LOG_ERR("Call `ctr_wdog_start` failed: %d", ret);
		return ret;
	}

#if defined(FEATURE_SUBSYSTEM_BUTTON)
	ret = ctr_button_set_event_cb(app_handler_ctr_button, NULL);
	if (ret) {
		LOG_ERR("Call `ctr_button_set_event_cb` failed: %d", ret);
		return ret;
	}
#endif /* defined(FEATURE_SUBSYSTEM_BUTTON) */

#if defined(FEATURE_SUBSYSTEM_DS18B20)
	ret = ctr_ds18b20_scan();
	if (ret) {
		LOG_ERR("Call `ctr_ds18b20_scan` failed: %d", ret);
		return ret;
	}
#endif /* defined(FEATURE_SUBSYSTEM_DS18B20) */

#if defined(FEATURE_SUBSYSTEM_SOIL_SENSOR)
	ret = ctr_soil_sensor_scan();
	if (ret) {
		LOG_ERR("Call `ctr_soil_sensor_scan` failed: %d", ret);
		return ret;
	}
#endif /* defined(FEATURE_SUBSYSTEM_SOIL_SENSOR) */

#if defined(FEATURE_HARDWARE_CHESTER_S1)
	static const struct device *dev = DEVICE_DT_GET(DT_NODELABEL(ctr_s1));

	if (!device_is_ready(dev)) {
		LOG_ERR("Device not ready");
		return -ENODEV;
	}

	ret = ctr_s1_set_handler(dev, ctr_s1_event_handler, NULL);
	if (ret) {
		LOG_ERR("Call `ctr_s1_set_handler` failed: %d", ret);
		return ret;
	}

	ret = ctr_s1_enable_interrupts(dev);
	if (ret) {
		LOG_ERR("Call `ctr_s1_enable_interrupts` failed: %d", ret);
		return ret;
	}

#endif /* defined(FEATURE_HARDWARE_CHESTER_S1) */

	switch (g_app_config.mode) {

#if defined(FEATURE_SUBSYSTEM_LRW)
	case APP_CONFIG_MODE_LRW:
		ret = ctr_lrw_init(app_handler_lrw, NULL);
		if (ret) {
			LOG_ERR("Call `ctr_lrw_init` failed: %d", ret);
			return ret;
		}

		ret = ctr_lrw_start(NULL);
		if (ret) {
			LOG_ERR("Call `ctr_lrw_start` failed: %d", ret);
			return ret;
		}

		k_sleep(K_SECONDS(2));
		break;
#endif /* defined(FEATURE_SUBSYSTEM_LRW) */

#if defined(FEATURE_SUBSYSTEM_LTE_V2)
	case APP_CONFIG_MODE_LTE:

        ctr_lte_v2_enable();

        while (true) {
			ret = ctr_lte_v2_wait_for_connected(K_SECONDS(60));
			if (!ret) {
				break;
			} else {
				if (ret == -ETIMEDOUT) {
					LOG_INF("Waiting for LTE connection");
				} else {
					LOG_ERR("Call `ctr_lte_v2_wait_for_connected` failed: %d",
						ret);
					return ret;
				}
			}

			ret = ctr_wdog_feed(&g_app_wdog_channel);
			if (ret) {
				LOG_ERR("Call `ctr_wdog_feed` failed: %d", ret);
				return ret;
			}
		}

		break;
#endif /* defined(FEATURE_SUBSYSTEM_LTE_V2) */

	default:
		break;
	}

	ctr_led_set(CTR_LED_CHANNEL_R, false);

	ret = app_work_init();
	if (ret) {
		LOG_ERR("Call `app_work_init` failed: %d", ret);
		return ret;
	}

#if defined(FEATURE_CHESTER_APP_TAMPER)
	ret = app_tamper_init();
	if (ret) {
		LOG_ERR("Call `app_tamper_init` failed: %d", ret);
		return ret;
	}
#endif /* defined(FEATURE_CHESTER_APP_TAMPER) */

#if defined(FEATURE_HARDWARE_CHESTER_Z) || defined(FEATURE_HARDWARE_CHESTER_X10)
	ret = app_backup_init();
	if (ret) {
		LOG_ERR("Call `app_backup_init` failed: %d", ret);
		return ret;
	}
#endif /* defined(FEATURE_HARDWARE_CHESTER_Z) || defined(FEATURE_HARDWARE_CHESTER_X10) */

#if defined(FEATURE_HARDWARE_CHESTER_X4_A) || defined(FEATURE_HARDWARE_CHESTER_X4_B)
	ret = init_chester_x4();
	if (ret) {
		LOG_ERR("Call `init_chester_x4` failed: %d", ret);
		return ret;
	}
#endif /* defined(FEATURE_HARDWARE_CHESTER_X4_A) || defined(FEATURE_HARDWARE_CHESTER_X4_B) */

	return 0;
}
```
